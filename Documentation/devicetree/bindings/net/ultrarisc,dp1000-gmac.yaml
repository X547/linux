## Documentation/devicetree/bindings/net/ultrarisc,dp1000-gmac.yaml
```yaml
# SPDX-License-Identifier: (GPL-2.0-only OR BSD-2-Clause)
%YAML 1.2
---
$id: http://devicetree.org/schemas/net/ultrarisc,dp1000-gmac.yaml#
$schema: http://devicetree.org/meta-schemas/core.yaml#

title: PLACEHOLDER GMAC BINDING

maintainers:
  - Foo Bar <fake@example.com>

select:
  properties:
    compatible:
      contains:
        enum:
          - ultrarisc,dp1000-gmac
  required:
    - compatible

properties:
  compatible:
    items:
      - const: ultrarisc,dp1000-gmac
      - const: snps,dwmac-5.10a

additionalProperties: true

...
```

## Documentation/devicetree/bindings/pci/ultrarisc,dw-pcie.yaml
```yaml
# SPDX-License-Identifier: (GPL-2.0-only OR BSD-2-Clause)
%YAML 1.2
---
$id: http://devicetree.org/schemas/pci/ultrarisc,dw-pcie.yaml#
$schema: http://devicetree.org/meta-schemas/core.yaml#

title: PLACEHOLDER PCIE BINDING

maintainers:
  - Foo Bar <fake@example.com>

properties:
  compatible:
    items:
      - const: ultrarisc,dw-pcie

additionalProperties: true

...
```

## Documentation/devicetree/bindings/riscv/ultrarisc.yaml
```yaml
# SPDX-License-Identifier: (GPL-2.0-only OR BSD-2-Clause)
%YAML 1.2
---
$id: http://devicetree.org/schemas/riscv/ultrarisc.yaml#
$schema: http://devicetree.org/meta-schemas/core.yaml#

title: UltraRisc SoC-based boards

maintainers:
  - Jia Wang <wangjia@ultrarisc.com>

description:
  UltraRisc SoC-based boards

properties:
  $nodename:
    const: '/'
  compatible:
    oneOf:
      - description: UltraRisc DP1000 SoC
        items:
          - const: ultrarisc,dp1000

additionalProperties: true

...
```
